## meta-edf-dev/conf/machine/arty-z7-20.conf
```bitbake
#@TYPE: Machine
#@NAME: arty-z7-20
#@DESCRIPTION: Machine configuration for the arty-z7-20 boards.


BBMULTICONFIG += "arty-z7-20-cortexa9-fsbl"

#### Preamble
MACHINEOVERRIDES =. "${@['', 'arty-z7-20:']['arty-z7-20' !='${MACHINE}']}"
#### Regular settings follow

# First Stage Boot Loader
FSBL_DEPENDS = ""
FSBL_MCDEPENDS = "mc::arty-z7-20-cortexa9-fsbl:fsbl-firmware:do_deploy"
FSBL_DEPLOY_DIR = "${TMPDIR}-arty-z7-20-cortexa9-fsbl/deploy/images/${MACHINE}"

# Set the default (linux) domain device tree
CONFIG_DTFILE_DIR := "${@bb.utils.which(d.getVar('BBPATH'), 'conf/dts/arty-z7-20')}"
CONFIG_DTFILE ?= "${CONFIG_DTFILE_DIR}/cortexa9-linux.dts"
CONFIG_DTFILE[vardepsexclude] += "CONFIG_DTFILE_DIR"

DTB_FILE_PATH ?= "${RECIPE_SYSROOT}/boot/devicetree/${@os.path.basename(d.getVar('CONFIG_DTFILE').replace('.dts', '.dtb'))}"

# Serial Console Settings
SERIAL_CONSOLES ?= "115200;ttyPS0"

# Yocto u-boot-xlnx variables

# Set DDR Base address for u-boot-xlnx-scr variables
DDR_BASEADDR ?= "0x100000"
SKIP_APPEND_BASEADDR ?= "0"

# Yocto KERNEL Variables
UBOOT_ENTRYPOINT ?= "0x300000"
UBOOT_LOADADDRESS ?= "0x300000"
KERNEL_EXTRA_ARGS += "UIMAGE_LOADADDR=${UBOOT_ENTRYPOINT}"

# Yocto MACHINE_FEATURES Variable
MACHINE_FEATURES += "fpga-overlay"

# Required generic machine inclusion
require conf/machine/zynq-generic.conf

# This is an 'SDT' based BSP
XILINX_WITH_ESW = "sdt"

# Original SDT artifacts URL
SDT_URI = "file:///hardware/arty-z7-20/sdt"
SDT_URI[S] = "${WORKDIR}/hardware/arty-z7-20/sdt"

# Set the system device trees
SYSTEM_DTFILE_DEPENDS = "sdt-artifacts"
SYSTEM_DTFILE_DIR = "${RECIPE_SYSROOT}${datadir}/sdt/${MACHINE}"
SYSTEM_DTFILE = "${SYSTEM_DTFILE_DIR}/system-top.dts"

# Load the dynamic machine features
include conf/machine/include/arty-z7-20/${BB_CURRENT_MC}-features.conf
LIBXIL_CONFIG = "conf/machine/include/arty-z7-20/${BB_CURRENT_MC}-libxil.conf"

# Primary Bootmode value
DEFAULT_HW_BOOT_MODE = "5"

# Update bootbin to use proper device tree
BIF_PARTITION_IMAGE[device-tree] = "${DTB_FILE_PATH}"

# Remap boot files to ensure the right device tree is listed first
IMAGE_BOOT_FILES =+ "devicetree/${@os.path.basename(d.getVar('CONFIG_DTFILE').replace('.dts', '.dtb'))}"

#### No additional settings should be after the Postamble
#### Postamble
PACKAGE_EXTRA_ARCHS:append = "${@['', ' arty_z7_20']['arty-z7-20' != '${MACHINE}']}"
```

## meta-edf-dev/conf/machine/include/arty-z7-20/arty-z7-20-cortexa9-fsbl-features.conf
```bitbake
MACHINE_FEATURES = "common coresightps-dcc devcfg dmaps emacps gpio gpiops iic qspips scugic scutimer scuwdt sdps uartlite uartps usbps xadcps"
```

## meta-edf-dev/conf/machine/include/zybo-z7-20/zybo-z7-20-cortexa9-fsbl-features.conf
```bitbake
MACHINE_FEATURES = "common coresightps-dcc devcfg dmaps emacps gpio gpiops iicps qspips scugic scutimer scuwdt sdps ttcps uartlite uartps usbps xadcps"
```
